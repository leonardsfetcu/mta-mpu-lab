/dts-v1/;
/plugin/;
/ {
	compatible = "brcm,bcm2835";
	fragment@0 {
		target = <&spidev0>;
		__overlay__ {
			status = "disabled";
		};
	};
		
	fragment@1 {
		target = <&spi0>;
		__overlay__ {
			status = "okay";
			#address-cells = <1>;
			#size-cells = <0>;

			bmp280: bmp280@0 {
				compatible = "mta-labs,bmp280-spi";
				reg = <0x0>;
				spi-max-frequency = <1000000>;
				spi-bits-per-word = <8>;
				status = "okay";
			};
		};
	};
};